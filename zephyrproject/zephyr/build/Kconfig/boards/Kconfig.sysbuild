## zephyrproject/zephyr/build/Kconfig/boards/Kconfig.sysbuild
```kconfig
# Load Sysbuild board Kconfig descriptions.
osource "/home/tmdals010126/zephyrproject/zephyr/boards/st/nucleo_l552ze_q/Kconfig.sysbuild"
```

## zephyrproject/zephyr/build_mpu/Kconfig/boards/Kconfig.defconfig
```kconfig
# Load Zephyr board defconfig descriptions.
osource "/home/tmdals010126/zephyrproject/zephyr/boards/st/nucleo_l552ze_q/Kconfig.defconfig"
```
